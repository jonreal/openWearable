/dts-v1/;
/plugin/;

/ {
  compatible = "ti,beaglebone", "ti,beaglebone-black","ti,am335x-bone-black-wireless", "ti,am355x-bone-blue";

  /* identification */
  part-number = "OPENWEARABLE";
  version = "00A0";

  /* state the resources this cape uses */
  exclusive-use =

    /**** I2C2 pins ****/
    "P9.21",  /* I2C2_SCL */
    "P9.22",  /* I2C2_SDA */

    /* the hardware IP uses */
    "i2c2";

    /*----- pin mux cheat sheet -----*/
    /* Bit 6 - SLEWCTRL - 0 (fast) | 1 (slow)
     * Bit 5 - RXACTIVE - 0 (reciever disable) | 1 (reciever enable)
     * Bit 4 - PULLTYPESEL - 0 (pulldown) | 1 (pullup)
     * Bit 3 - PULLUDEN - 0 (enable) | 1 (disable)
     * Bit 2-0 - MUXMODE
     */
  /*----- pin mux -----*/
  fragment@0 {
    target = <&am33xx_pinmux>;
    __overlay__ {

      i2c2_pins: pinmux_i2c2_pins{
        pinctrl-single,pins = <
          0x15C 0x72  /* P9.21 - i2c2_scl, MODE2 | INPUT_PULLUP (bi-dir)*/
          0x158 0x72  /* P9.22 - i2c2_sda, MODE2 | INPUT_PULLUP (bi-dir)*/
        >;
      };
    };
  };
  /*----- I2C2 ------*/
  fragment@2 {
    target = <&i2c2>;
    __overlay__ {
      #address-cells = <1>;
      #size-cells = <1>;
      status = "okay";
      pinctrl-names = "default";
      pinctrl-0 = <&i2c2_pins>;
    };
 };
};


